## sdkconfig.defaults
```kconfig
CONFIG_IDF_EXPERIMENTAL_FEATURES=y
CONFIG_ESP32P4_SELECTS_REV_LESS_V3=y
CONFIG_ESP32P4_REV_MIN_100=y
CONFIG_ESP_CONSOLE_USB_SERIAL_JTAG=y
CONFIG_PLANT_AI_ENABLE_LCD_DISPLAY=y
CONFIG_PLANT_AI_FORCE_RGB_LCD_7084=y
# CONFIG_PLANT_AI_SCREEN_TEST_ON_BOOT is not set
```
